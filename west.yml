## west.yml
```yaml
manifest:
  defaults:
    revision: main
  remotes:
    - name: zephyrproject-rtos
      url-base: https://github.com/zephyrproject-rtos
  projects:
    - name: zephyr
      remote: zephyrproject-rtos
      revision: v3.4.0
      # import:
      #   path-prefix: ext
  # self:
  #   path: application
```
