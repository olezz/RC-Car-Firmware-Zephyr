## CMakeLists.txt
```
# SPDX-License-Identifier: Apache-2.0
# order of commands matters!
cmake_minimum_required(VERSION 3.20.0)

find_package(Zephyr REQUIRED HINTS $ENV{ZEPHYR_BASE})
# find_package(Zephyr)

project(blinky)

target_sources(app PRIVATE src/main.c)
```

## west.yml
```
manifest:
  defaults:
    revision: main
  remotes:
    - name: zephyrproject-rtos
      url-base: https://github.com/zephyrproject-rtos
  projects:
    - name: zephyr
      remote: zephyrproject-rtos
      revision: v4.1.0
      import:
        path-prefix: ext
  self:
    path: application/
```

## prj.conf
```kconfig
CONFIG_GPIO=y
CONFIG_DEBUG=y
CONFIG_DEBUG_THREAD_INFO=n
```

## src/main.c
```c
#include <zephyr/kernel.h>

//branch main
int main(void)
{
    while (true)
    {
        printk("Hello!\n");
        k_msleep(1000);
    }
    return 0;
}
```
